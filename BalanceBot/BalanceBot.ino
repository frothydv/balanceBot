// BalanceBot — two-wheel self-balancing robot
//
// Hardware: Arduino Uno, MPU6050 (GY-521) on I2C (A4/A5), two bipolar steppers
// each driven by an L298N. Pin assignments were recovered from the original firmware.
//
// Control: complementary-filtered tilt -> PD loop that commands wheel *acceleration*,
// integrated into wheel speed. An outer loop leans the target angle against wheel
// speed/position so the bot doesn't run away. Steps are generated by a Timer1 ISR,
// so motor speed is smooth and continuous instead of one blocking step per loop.
//
// Auto-trim: a wrong balance-point estimate (or a load that shifts the CG) pushes the bot
// off its spot, so while balancing the trim keeps shifting until it is back home with the
// wheels stopped. The learned trim is saved when the bot disarms after a good run.
//
// Serial (115200 baud), one command per line:
//   p <n>  Kp      d <n>  Kd      v <n>  Kv      x <n>  Kx      t <n>  trim angle
//   i <n>  auto-trim rate (0 = off)    P <n>  idle coil drive % (100 = always full power)
//   z      set trim to current angle (hold the bot at its balance point first)
//   a      toggle auto-arm          k      kill (disarm)        f      flip drive direction
//   m      toggle telemetry         s      show settings        w      save to EEPROM
//   r      reset to defaults        M      motor test (disarmed only)

#include <Wire.h>
#include <EEPROM.h>
#include <util/atomic.h>

// ---------- Hardware ----------
// Pin order matches the Arduino Stepper library (IN1..IN4), as the original firmware used.
const uint8_t MOTOR_A_PINS[4] = {8, 9, 10, 11};
const uint8_t MOTOR_B_PINS[4] = {3, 4, 5, 6};
const bool MOTOR_A_REVERSED = false;
const bool MOTOR_B_REVERSED = true;   // the motors face each other, so one runs mirrored
const bool HALF_STEP = true;          // smoother and cooler; single-coil steps get boosted drive
const uint8_t STEP_SCALE = HALF_STEP ? 2 : 1;  // control math stays in full steps

const uint8_t MPU_ADDR = 0x68;
const uint8_t LED_PIN = 13;

// Tilt is rotation about the IMU's Y axis (the original firmware balanced on DMP pitch).
const float GYRO_SIGN = -1;           // makes gyro rate match d(accel angle)/dt
const float GYRO_LSB_PER_DPS = 65.5;  // +/-500 deg/s range

// ---------- Timing ----------
const uint16_t STEP_ISR_HZ = 20000;
const uint32_t LOOP_US = 5000;        // 200 Hz control loop
const float DT = LOOP_US / 1e6f;

// ---------- Limits ----------
const float MAX_SPEED = 800;          // steps/s; steppers on an L298N stall beyond roughly this
const float MAX_ACCEL = 12000;        // steps/s^2
const float MAX_LEAN = 8;             // degrees the outer loop may shift the target angle
const float FALL_ANGLE = 30;          // disarm beyond this tilt from upright
const float ARM_ANGLE = 3;            // auto-arm once held within this of upright...
const uint16_t ARM_HOLD_MS = 500;     // ...for this long
const float TRIM_LEARN_TILT = 10;     // only learn trim while within this of upright
const uint32_t TRIM_SAVE_MS = 5000;  // save learned trim after balancing at least this long
const uint16_t RUNAWAY_MS = 1500;     // disarm if pinned at max speed this long (can't recover)
const float RATE_FILTER = 0.5;        // smoothing on the gyro rate used for damping (~20 Hz)

// Adaptive coil drive: idle at cfg.minPower, rise to full as acceleration/speed demand grows.
const float POWER_FULL_ACCEL = 6000;  // steps/s^2 demand that calls for full drive
const float POWER_FULL_SPEED = 600;   // steps/s that calls for full drive (back-EMF eats torque)
const float POWER_DECAY = 0.98;       // per loop: ~0.25 s to ease back down after a boost

// Declared before any function so Arduino's generated prototypes can see it.
struct Motor {
  volatile uint8_t *port;  // all four pins must share one port (true for 8-11 and 3-6)
  uint8_t allMask;
  uint8_t patBits[16];     // port bits for each 4-bit coil pattern
  volatile int16_t speed;  // half or full steps/s, signed
  uint16_t acc;
  uint16_t pwm;            // sigma-delta accumulator for coil drive duty
  uint8_t phase;
  bool reversed;
};

// ---------- Tunable settings (saved in EEPROM) ----------
struct Settings {
  uint16_t magic;
  float kp;      // steps/s^2 per degree of tilt
  float kd;      // steps/s^2 per deg/s of tilt rate
  float kv;      // degrees of lean per step/s of wheel speed
  float kx;      // degrees of lean per step of wheel travel
  float trim;    // angle reading at the balance point
  float alpha;   // complementary filter gyro weight
  bool autoArm;
  bool flip;     // invert drive direction relative to tilt
  float ktrim;   // degrees of trim correction per second, per step away from home
  float minPower;  // idle coil drive, 0..1 (1 = always full, like a plain L298N)
};
const uint16_t SETTINGS_MAGIC = 0xBB06;
Settings cfg;

void loadDefaults() {
  // kd sized for the ~17 cm effective pendulum length measured from a free fall.
  // kv/kx from the first run: 0.004 let it reach the speed cap and run away.
  // kv, kx and ktrim form a PID on wheel position: a CG shift first pushes the bot off
  // its spot, then trim keeps moving until it is back home on the true balance point.
  // Trim 2.4 is what the bare bot learned.
  cfg = {SETTINGS_MAGIC, 250, 22, 0.01, 0.01, 2.4, 0.995, true, false, 0.003, 1.0};
}

// ---------- Stepper driver ----------
// Bit k of a pattern drives pin k (IN1..IN4). Same full-step order as Stepper.cpp.
const uint8_t FULL_SEQ[4] = {0b0101, 0b0110, 0b1010, 0b1001};
const uint8_t HALF_SEQ[8] = {0b0101, 0b0100, 0b0110, 0b0010, 0b1010, 0b1000, 0b1001, 0b0001};
const uint8_t *const SEQ = HALF_STEP ? HALF_SEQ : FULL_SEQ;
const uint8_t SEQ_MASK = HALF_STEP ? 7 : 3;

Motor motors[2];
volatile bool coilsOn = false;
// Coil drive duty, 0..255. Chopping pulls both IN pins of a bridge low, which on an L298N
// shorts the coil through the low-side transistors so current coasts smoothly (slow decay).
volatile uint8_t dutyDouble = 255;  // patterns with both coils energized
volatile uint8_t dutySingle = 255;  // half-step patterns with one coil: boosted to match torque

void initMotor(Motor &m, const uint8_t pins[4], bool reversed) {
  m.port = portOutputRegister(digitalPinToPort(pins[0]));
  m.allMask = 0;
  for (uint8_t k = 0; k < 4; k++) {
    pinMode(pins[k], OUTPUT);
    digitalWrite(pins[k], LOW);
    if (portOutputRegister(digitalPinToPort(pins[k])) != m.port) {
      Serial.println(F("# motor pins must share one port"));
      while (true) {}
    }
    m.allMask |= digitalPinToBitMask(pins[k]);
  }
  for (uint8_t p = 0; p < 16; p++) {
    m.patBits[p] = 0;
    for (uint8_t k = 0; k < 4; k++)
      if (p & (1 << k)) m.patBits[p] |= digitalPinToBitMask(pins[k]);
  }
  m.speed = 0;
  m.acc = 0;
  m.pwm = 0;
  m.phase = 0;
  m.reversed = reversed;
}

static inline void tickMotor(Motor &m) {
  int16_t s = m.speed;
  if (s != 0) {
    m.acc += (s < 0) ? -s : s;
    if (m.acc >= STEP_ISR_HZ) {
      m.acc -= STEP_ISR_HZ;
      bool fwd = (s > 0) != m.reversed;
      m.phase = (m.phase + (fwd ? 1 : -1)) & SEQ_MASK;
    }
  }

  // First-order sigma-delta spreads the off-time evenly, giving 10-20 kHz chopping.
  uint8_t pattern = SEQ[m.phase];
  bool single = (pattern & (pattern - 1)) == 0;
  m.pwm += single ? dutySingle : dutyDouble;
  uint8_t out = 0;
  if (m.pwm >= 255) {
    m.pwm -= 255;
    if (coilsOn) out = pattern;
  }
  *m.port = (*m.port & ~m.allMask) | m.patBits[out];
}

ISR(TIMER1_COMPA_vect) {
  tickMotor(motors[0]);
  tickMotor(motors[1]);
}

void setSpeed(float fullStepsPerSec) {
  float s = fullStepsPerSec * STEP_SCALE;
  int16_t v = (int16_t)(cfg.flip ? -s : s);
  ATOMIC_BLOCK(ATOMIC_RESTORESTATE) {
    motors[0].speed = v;
    motors[1].speed = v;
  }
}

// Fraction of full coil drive, 0..1. Current, and so torque, scales with it.
void setPower(float p) {
  p = constrain(p, 0, 1);
  dutyDouble = (uint8_t)(p * 255);
  dutySingle = (uint8_t)min(255.0f, p * 255 * (HALF_STEP ? 1.414f : 1.0f));
}

void enableMotors(bool on) {
  setSpeed(0);
  coilsOn = on;
}

// ---------- IMU ----------
float gyroBias = 0;
uint8_t imuFailures = 0;

void mpuWrite(uint8_t reg, uint8_t val) {
  Wire.beginTransmission(MPU_ADDR);
  Wire.write(reg);
  Wire.write(val);
  Wire.endTransmission();
}

bool initImu() {
  Wire.beginTransmission(MPU_ADDR);
  Wire.write(0x75);  // WHO_AM_I
  if (Wire.endTransmission(false) != 0 || Wire.requestFrom(MPU_ADDR, (uint8_t)1) != 1) return false;
  uint8_t id = Wire.read();
  if (id != 0x68) {
    Serial.print(F("Note: WHO_AM_I = 0x"));
    Serial.println(id, HEX);  // clones report other IDs but usually work
  }
  mpuWrite(0x6B, 0x01);  // wake, clock from gyro PLL
  mpuWrite(0x1A, 0x03);  // DLPF ~44 Hz: cuts stepper cogging vibration
  mpuWrite(0x1B, 0x08);  // gyro +/-500 deg/s
  mpuWrite(0x1C, 0x00);  // accel +/-2 g
  delay(50);
  return true;
}

bool readImu(int16_t &ax, int16_t &ay, int16_t &az, int16_t &gy) {
  Wire.beginTransmission(MPU_ADDR);
  Wire.write(0x3B);
  if (Wire.endTransmission(false) != 0) return false;
  if (Wire.requestFrom(MPU_ADDR, (uint8_t)14) != 14) return false;
  int16_t raw[7];
  for (int16_t &r : raw) r = (Wire.read() << 8) | Wire.read();
  ax = raw[0];
  ay = raw[1];
  az = raw[2];
  gy = raw[5];
  return true;
}

float accelAngle(int16_t ax, int16_t ay, int16_t az) {
  return atan2((float)ax, sqrt((float)ay * ay + (float)az * az)) * RAD_TO_DEG;
}

void calibrateGyro() {
  Serial.println(F("Calibrating gyro - keep the bot still..."));
  long sum = 0;
  int n = 0;
  for (int i = 0; i < 500; i++) {
    int16_t ax, ay, az, gy;
    if (readImu(ax, ay, az, gy)) {
      sum += gy;
      n++;
    }
    delay(2);
  }
  gyroBias = n ? (float)sum / n : 0;
  Serial.print(F("Gyro bias: "));
  Serial.println(gyroBias);
}

// ---------- Control ----------
float angle = 0;      // filtered tilt, degrees
float rate = 0;       // tilt rate, deg/s
float rateFilt = 0;   // smoothed tilt rate for the damping term
float accAngle = 0;   // raw accelerometer angle, for diagnostics
float target = 0;     // target tilt from the outer loop
float speedCmd = 0;   // common wheel speed, steps/s
float speedFilt = 0;
float position = 0;   // steps travelled since arming
bool armed = false;
uint32_t uprightSince = 0;
uint32_t armedAt = 0;
uint32_t pinnedSince = 0;   // when the wheels last hit max speed
float trimAtArm = 0;
float power = 1;      // current coil drive fraction

void arm() {
  speedCmd = speedFilt = position = 0;
  power = 1;          // start firm, then ease down to what balancing needs
  setPower(power);
  enableMotors(true);
  armed = true;
  armedAt = millis();
  pinnedSince = 0;
  trimAtArm = cfg.trim;
  digitalWrite(LED_PIN, HIGH);
  Serial.println(F("# armed"));
}

void disarm(const __FlashStringHelper *why) {
  bool wasArmed = armed;
  enableMotors(false);
  armed = false;
  speedCmd = 0;
  uprightSince = 0;
  digitalWrite(LED_PIN, LOW);
  Serial.print(F("# disarmed: "));
  Serial.println(why);

  // Save the learned trim here rather than mid-balance: EEPROM writes block for milliseconds.
  if (wasArmed && millis() - armedAt > TRIM_SAVE_MS && fabs(cfg.trim - trimAtArm) > 0.05f) {
    EEPROM.put(0, cfg);
    Serial.print(F("# learned trim saved: "));
    Serial.println(cfg.trim);
  }
}

void control() {
  float tilt = angle - cfg.trim;

  if (!armed) {
    if (cfg.autoArm && fabs(tilt) < ARM_ANGLE && fabs(rate) < 20) {
      if (!uprightSince) uprightSince = millis() | 1;
      else if (millis() - uprightSince > ARM_HOLD_MS) arm();
    } else {
      uprightSince = 0;
    }
    return;
  }

  if (fabs(tilt) > FALL_ANGLE) {
    disarm(F("fell over"));
    return;
  }

  // At max speed the wheels can't get ahead of the body to lean it back, so it just rides
  // along. Stop rather than chase it across the room.
  if (fabs(speedCmd) >= MAX_SPEED) {
    if (!pinnedSince) pinnedSince = millis() | 1;
    else if (millis() - pinnedSince > RUNAWAY_MS) {
      disarm(F("runaway at max speed"));
      return;
    }
  } else {
    pinnedSince = 0;
  }

  // Outer loop: lean against wheel speed and travel so the bot stays in place.
  speedFilt += 0.05f * (speedCmd - speedFilt);
  position += speedCmd * DT;
  target = constrain(-cfg.kv * speedFilt - cfg.kx * position, -MAX_LEAN, MAX_LEAN);

  // Auto-trim: having to sit forward of home means trim is set too high, and vice versa.
  // Integrating keeps correcting until the bot is back home, so the trim converges on the
  // true balance point. Skip it when pinned at max speed or far from upright (held, falling).
  if (fabs(speedCmd) < MAX_SPEED && fabs(tilt) < TRIM_LEARN_TILT) {
    cfg.trim -= cfg.ktrim * position * DT;
  }

  // Inner loop: drive the wheels under the center of mass.
  float accel = constrain(cfg.kp * (tilt - target) + cfg.kd * rateFilt, -MAX_ACCEL, MAX_ACCEL);
  speedCmd = constrain(speedCmd + accel * DT, -MAX_SPEED, MAX_SPEED);
  setSpeed(speedCmd);

  // Push only as hard as needed: boost instantly with demand, ease back down slowly.
  float demand = min(1.0f, fabs(accel) / POWER_FULL_ACCEL + fabs(speedCmd) / POWER_FULL_SPEED);
  float want = cfg.minPower + (1 - cfg.minPower) * demand;
  power = max(want, power * POWER_DECAY);
  setPower(power);
}

// ---------- Serial interface ----------
bool telemetry = true;
char line[24];
uint8_t lineLen = 0;

void showSettings() {
  Serial.print(F("# kp=")); Serial.print(cfg.kp);
  Serial.print(F(" kd=")); Serial.print(cfg.kd);
  Serial.print(F(" kv=")); Serial.print(cfg.kv, 4);
  Serial.print(F(" kx=")); Serial.print(cfg.kx, 4);
  Serial.print(F(" trim=")); Serial.print(cfg.trim);
  Serial.print(F(" ktrim=")); Serial.print(cfg.ktrim, 4);
  Serial.print(F(" minPower=")); Serial.print(cfg.minPower * 100, 0);
  Serial.print(F(" autoArm=")); Serial.print(cfg.autoArm);
  Serial.print(F(" flip=")); Serial.println(cfg.flip);
}

void runMotor(int8_t which, float speed, uint16_t ms) {
  ATOMIC_BLOCK(ATOMIC_RESTORESTATE) {
    int16_t s = (int16_t)(speed * STEP_SCALE);
    motors[0].speed = (which != 1) ? s : 0;
    motors[1].speed = (which != 0) ? s : 0;
  }
  delay(ms);
  setSpeed(0);
  delay(300);
}

void motorTest() {
  if (armed) return;
  setPower(1);
  enableMotors(true);
  Serial.println(F("# motor A forward, back")); runMotor(0, 200, 1000); runMotor(0, -200, 1000);
  Serial.println(F("# motor B forward, back")); runMotor(1, 200, 1000); runMotor(1, -200, 1000);
  Serial.println(F("# both forward, back"));    runMotor(2, 200, 1000); runMotor(2, -200, 1000);
  enableMotors(false);
  Serial.println(F("# motor test done"));
}

void handleCommand(char *cmd) {
  float val = atof(cmd + 1);
  switch (cmd[0]) {
    case 'p': cfg.kp = val; break;
    case 'd': cfg.kd = val; break;
    case 'v': cfg.kv = val; break;
    case 'x': cfg.kx = val; break;
    case 't': cfg.trim = val; break;
    case 'i': cfg.ktrim = val; break;
    case 'P': cfg.minPower = constrain(val / 100, 0.1f, 1.0f); break;
    case 'z': cfg.trim = angle; break;
    case 'a': cfg.autoArm = !cfg.autoArm; break;
    case 'f': cfg.flip = !cfg.flip; break;
    case 'k': disarm(F("command")); return;
    case 'm': telemetry = !telemetry; return;
    case 'w': EEPROM.put(0, cfg); Serial.println(F("# saved")); return;
    case 'r': loadDefaults(); break;
    case 'M': motorTest(); return;
    case 's': break;
    default: Serial.println(F("# unknown command")); return;
  }
  showSettings();
}

void pollSerial() {
  while (Serial.available()) {
    char c = Serial.read();
    if (c == '\n' || c == '\r') {
      if (lineLen) {
        line[lineLen] = 0;
        handleCommand(line);
        lineLen = 0;
      }
    } else if (lineLen < sizeof(line) - 1) {
      line[lineLen++] = c;
    }
  }
}

void printTelemetry() {
  // angle, accel-only angle, rate, target, wheel speed, armed, trim, power %
  Serial.print(angle); Serial.print('\t');
  Serial.print(accAngle); Serial.print('\t');
  Serial.print(rate); Serial.print('\t');
  Serial.print(target); Serial.print('\t');
  Serial.print(speedCmd, 0); Serial.print('\t');
  Serial.print(armed); Serial.print('\t');
  Serial.print(cfg.trim); Serial.print('\t');
  Serial.println(power * 100, 0);
}

// ---------- Main ----------
void setup() {
  Serial.begin(115200);
  pinMode(LED_PIN, OUTPUT);

  initMotor(motors[0], MOTOR_A_PINS, MOTOR_A_REVERSED);
  initMotor(motors[1], MOTOR_B_PINS, MOTOR_B_REVERSED);
  TCCR1A = 0;
  TCCR1B = _BV(WGM12) | _BV(CS10);  // CTC, no prescaler
  OCR1A = F_CPU / STEP_ISR_HZ - 1;
  TIMSK1 = _BV(OCIE1A);

  EEPROM.get(0, cfg);
  if (cfg.magic != SETTINGS_MAGIC) loadDefaults();

  Wire.begin();
  Wire.setClock(400000);
  Wire.setWireTimeout(3000, true);
  Serial.println(F("# BalanceBot"));
  while (!initImu()) {
    Serial.println(F("# MPU6050 not found - check wiring"));
    delay(1000);
  }
  calibrateGyro();

  int16_t ax, ay, az, gy;
  if (readImu(ax, ay, az, gy)) angle = accelAngle(ax, ay, az);
  showSettings();
  Serial.println(F("# angle\taccAngle\trate\ttarget\tspeed\tarmed\ttrim\tpower"));
}

void loop() {
  static uint32_t nextLoop = micros();
  static uint8_t telemetryDiv = 0;

  pollSerial();
  if ((int32_t)(micros() - nextLoop) < 0) return;
  nextLoop += LOOP_US;

  int16_t ax, ay, az, gy;
  if (!readImu(ax, ay, az, gy)) {
    if (++imuFailures >= 3) {
      if (armed) disarm(F("IMU read failed"));
      initImu();
      imuFailures = 0;
    }
    return;
  }
  imuFailures = 0;

  accAngle = accelAngle(ax, ay, az);
  rate = GYRO_SIGN * (gy - gyroBias) / GYRO_LSB_PER_DPS;
  rateFilt += RATE_FILTER * (rate - rateFilt);
  angle = cfg.alpha * (angle + rate * DT) + (1 - cfg.alpha) * accAngle;

  control();

  if (!armed) digitalWrite(LED_PIN, (millis() >> 9) & 1);  // slow blink while waiting
  if (telemetry && ++telemetryDiv >= 8) {                     // 25 Hz
    telemetryDiv = 0;
    printTelemetry();
  }
}
